## embedded80211/zephyr/dts/bindings/embedded80211,bt-hci-virtual.yaml
```yaml
# Copyright (c) 2022 Nordic Semiconductor ASA
#
# SPDX-License-Identifier: LicenseRef-Nordic-5-Clause

description: |
  Virtual Bluetooth HCI driver backed by the embedded80211 link-protocol bus.
  H:4 HCI traffic is proxied to a radio co-processor over the serial link;
  this is the host-role mirror of the device's BT HCI proxy.

compatible: "embedded80211,bt-hci-virtual"
```

## embedded80211/zephyr/dts/bindings/embedded80211,virt-wifi.yaml
```yaml
# Copyright (c) 2022 Nordic Semiconductor ASA
#
# SPDX-License-Identifier: LicenseRef-Nordic-5-Clause

description: |
  Virtual Wi-Fi L2 interface backed by the embedded80211 link-protocol bus.
  Management requests and data frames are proxied to a radio co-processor
  over the serial link; this is the host-role mirror of the device's
  Wi-Fi management/data proxies.

compatible: "embedded80211,virt-wifi"
```

## host/boards/renode_cortex_m3/board.yml
```yaml
board:
  name: renode_cortex_m3
  full_name: Renode Emulation for ARM Cortex-M3
  vendor: renode
  socs:
  - name: renode_cortex_m3
```
